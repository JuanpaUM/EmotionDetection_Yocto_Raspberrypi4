## conf/bblayers.conf
```bitbake
# POKY_BBLAYERS_CONF_VERSION is increased each time build/conf/bblayers.conf
# changes incompatibly
POKY_BBLAYERS_CONF_VERSION = "2"

BBPATH = "${TOPDIR}"
BBFILES ?= ""

BBLAYERS ?= " \
  /home/jpv/Yocto/poky/meta \
  /home/jpv/Yocto/poky/meta-poky \
  /home/jpv/Yocto/poky/meta-yocto-bsp \
  /home/jpv/Yocto/poky/meta-raspberrypi \
  /home/jpv/Yocto/poky/meta-openembedded/meta-oe \
  /home/jpv/Yocto/poky/meta-openembedded/meta-python \
  /home/jpv/Yocto/poky/meta-tensorflow-lite \
  /home/jpv/Yocto/poky/meta-proyecto \
  "
```
